## components/MCP2518FD/Kconfig
```kconfig
menu "MCP2518FD Configuration"

    config MCP2518_ASSERT
        bool "Enable assertions"
        default y
        help
            If this is set, assertion checks are enabled and failed assertions will
            crash the application.
    config MCP2518_DEBUG_PRINT
        bool "Enable debug prints"
        default n
        help
            Enables rather verbose printing that may be useful for debugging, e.g.
            printing on every register read and write

    config MCP2518_CRC_ENABLE
        bool "Enable CRC check on register reads and writes"
        default n
        help
            If enabled, all register reads and writes will use the *_CRC opcodes
            and compare the locally calculated CRC with one read from the MCP2518

    config MCP2518_ATTR
        bool "Place fast path functions in IRAM"
        default n
        help
            Places "fast path" functions, i.e. sending and receiving messages, into
            IRAM rather than flash memory, thus decreasing the likelihood of experencing
            instruction cache misses

    config MCP2518_INSTALL_GPIO_ISR
        bool "Install GPIO ISR Service"
        default y
        help
            Controls whether this component installs the GPIO ISR service. This needs to be done somewhere, so
            if another component in the application already installs the service, this option allows for this component
            to skip this step.

    config EXTENDED_ID_HW_WORKAROUND
        bool "Extended ID HW Workaround"
        default n
        help
            For unknown reasons, when setting the IDE bit (extended ID), the MCP2518FD seems to rotate the standard ID
            and extended ID bits. If you are seeing unexpected headers when extended IDs are used, try enabling.

endmenu
```

## main/Kconfig.projbuild
```kconfig
menu "MCP2518FD Example"

    orsource "$IDF_PATH/examples/common_components/env_caps/$IDF_TARGET/Kconfig.env_caps"

    choice
        prompt "SPI Host"
        config SPI2_ENABLE
            bool "SPI2"
        config SPI3_ENABLE
            bool "SPI3"
    endchoice

    config SPI_CS_PIN
    int "SPI CS"
    range ENV_GPIO_RANGE_MIN ENV_GPIO_IN_RANGE_MAX
    default 15

    config SPI_MOSI_PIN
    int "SPI MOSI"
    range ENV_GPIO_RANGE_MIN ENV_GPIO_IN_RANGE_MAX
    default 12

    config SPI_MISO_PIN
    int "SPI MISO"
    range ENV_GPIO_RANGE_MIN ENV_GPIO_IN_RANGE_MAX
    default 13

    config SPI_CLK_PIN
    int "SPI Clock"
    range ENV_GPIO_RANGE_MIN ENV_GPIO_IN_RANGE_MAX
    default 14

    config RX_INTR_PIN
    int "RX interrupt input"
    range -1 ENV_GPIO_IN_RANGE_MAX
    default -1
    help
        INT1 on MCP2518FD. -1 indicates unused

    config TX_INTR_PIN
    int "TX interrupt input"
    range -1 ENV_GPIO_IN_RANGE_MAX
    default -1
    help
        INT0 on MCP2518FD. -1 indicates unused

endmenu
```
